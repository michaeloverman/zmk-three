## config/boards/shields/brown_over/Kconfig.defconfig
```kconfig
if SHIELD_BROWN_OVER_LEFT

config ZMK_KEYBOARD_NAME
    default "Brown Over Heart"

config ZMK_SPLIT_ROLE_CENTRAL
    default y

endif

if SHIELD_BROWN_OVER_LEFT || SHIELD_BROWN_OVER_RIGHT

config ZMK_SPLIT
    default y

endif
```

## config/boards/shields/brown_over/Kconfig.shield
```kconfig
config SHIELD_BROWN_OVER_LEFT
    def_bool $(shields_list_contains,brown_over_left)

config SHIELD_BROWN_OVER_RIGHT
    def_bool $(shields_list_contains,brown_over_right)
```
